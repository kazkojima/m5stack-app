## i2s-input/main/Kconfig.projbuild
```kconfig
menu "I2S input Configuration"

config SSID
    string "WIFI access point name (SSID)"
    default "ssid_of_your_ap"
    help
        Enter the name of the WIFI access point

config SSID_PASSWORD
    string "WIFI password"
    default "password_of_your_ap"
    help
        Enter ssid password

config UDP_ADDRESS
    string "IPv4 address of server"
    default "192.168.11.1"
    help
        IP address of the server

config UDP_PORT
    int "UDP port"
    default 5990
    help
        UDP port used for both Wi-Fi and ether

config I2S_BCK_GPIO
    int "BCK gpio num"
    range 1 26
    default 17
    help
        GPIO pin for I2S BCK signal

config I2S_DATAIN_GPIO
    int "DATA_IN gpio num"
    range 1 26
    default 16
    help
        GPIO pin for I2S DATA IN signal

config I2S_WS_GPIO
    int "WS gpio num"
    range 1 26
    default 5
    help
        GPIO pin for I2S WS signal

config I2S_NUM
    int "I2S "
    range 0 1
    default 0
    help
        I2S unit number (default 0)

config I2S_SAMPLE_RATE
    int "sample rate"
    default 8000
    help
        I2S sample rate (default 8000)

choice I2S_CHANNEL_FORMAT
    prompt "channel format"
    default I2S_ONLY_RIGHT
    help
        I2S channel formats. Select from STEREO/ONLY_RIGHT/ONLY_LEFT.

config I2S_STEREO
    bool "LEFT and RIGHT input both"
config I2S_ONLY_RIGHT
    bool "RIGHT input only"
config I2S_ONLY_LEFT
    bool "LEFT input only"
endchoice

config I2S_DMA_BUF_NUM
    int "number of DMA buffer"
    range 4 16
    default 8
    help
        Specify how many DMA buffers to be used

config I2S_MCLK_GPIO1
    bool "MCLK to GPIO 1"
    default false
    help
	Enable I2S master clock output at GPIO 1 (CLK_OUT3)

config I2S_DISPLAY_FFT
    bool "DISPLAY FFT result"
    default true
    help
	If set, display FFT result

endmenu
```

## m5-propo/main/Kconfig.projbuild
```kconfig
menu "M5 controller Configuration"

config SSID
    string "WIFI access point name (SSID)"
    default "hachidori_ap"
    help
        Enter the name of the WIFI access point

config SSID_PASSWORD
    string "WIFI password"
    default "e15f44ecdff3a"
    help
        Enter ssid password

config APM_SERVER_ADDRESS
    string "IPv4 address of server"
    default "192.168.11.1"
    help
        IP address of the server, normaly same with AP_ADDRESS

config UDP_PORT
    int "UDP port"
    default 5990
    help
        UDP port used for both Wi-Fi and ether

config TELEMETORY_PORT
    int "telemetory port"
    default 5900
    help
        TCP port which host uses for telemetry

config THROTTLE_BUTTON
    bool "Enable throttle buttons"
    default "y"
    help
	If enabled, 3 buttons are used for throttle work. A:decending, B:middling, C:accending.

config THROTTLE_HOVER
    int "Throttle value for hover"
    depends on THROTTLE_BUTTON
    default 1500
    range 1400 1600
    help
	Hover throttle PWM value. With pressing button B, throttle becomes to this value at constant rate.

choice
    prompt "How to display channel values"
    default DISPLAY_TYPE_BAR

config DISPLAY_TYPE_BAR
    bool "Display with bars"
    
config DISPLAY_TYPE_MARK
    bool "Display with x mark"

endchoice

config DISPLAY_COMPASS
    bool "Display estimated compass"
    depends on DISPLAY_TYPE_MARK
    default "n"
    help
	If enabled, display estimated north direction. Only when DISPLAY_TYPE is 2.

config ZHINANCHE
    bool "Enable ZHINANCHE mode"
    default "n"
    help
	If enabled, use mag for calibration only.

config MAG_H_INTENSITY
    int "Geomagnetic horizontal intensity"
    default 296
    help
	Geomagnetic horizontal intensity in milli gauss.

config MAG_V_INTENSITY
    int "Geomagnetic vertical intensity"
    default 372
    help
	Geomagnetic vertical intensity in milli gauss.

endmenu
```

## m5-rotor/main/Kconfig.projbuild
```kconfig
menu "M5 rotor identifier Configuration"

config SSID
    string "WIFI access point name (SSID)"
    default "your_ap_ssid"
    help
        Enter the name of the WIFI access point

config SSID_PASSWORD
    string "WIFI password"
    default "your_ap_password"
    help
        Enter ssid password

config SERVER_ADDRESS
    string "IPv4 address of server"
    default "192.168.11.1"
    help
        IP address of the server, normaly same with AP_ADDRESS

config TCP_PORT
    int "TCP port"
    default 6860
    help
        TCP port used for sending result

config ZHINANCHE
    bool "Enable ZHINANCHE mode"
    default "n"
    help
	If enabled, use mag for calibration only.

config MAG_H_INTENSITY
    int "Geomagnetic horizontal intensity"
    default 296
    help
	Geomagnetic horizontal intensity in milli gauss.

config MAG_V_INTENSITY
    int "Geomagnetic vertical intensity"
    default 372
    help
	Geomagnetic vertical intensity in milli gauss.

endmenu
```

## mavtest/main/Kconfig.projbuild
```kconfig
menu "M5 controller Configuration"

config SSID
    string "WIFI access point name (SSID)"
    default "hachidori_ap"
    help
        Enter the name of the WIFI access point

config SSID_PASSWORD
    string "WIFI password"
    default "e15f44ecdff3a"
    help
        Enter ssid password

config APM_SERVER_ADDRESS
    string "IPv4 address of APM host"
    default "192.168.11.1"
    help
        IP address of the APM host, normaly same with AP_ADDRESS

config TELEMETORY_PORT
    int "telemetory port"
    default 5900
    help
        TCP port which host uses for telemetry

endmenu
```
